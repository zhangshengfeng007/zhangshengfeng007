
#include <stdio.h>
#include <stdlib.h>
#include <stdint.h>
#include <string.h>

#include "ui_draw.h"

#include "User_System_Config.h"


unsigned char lcd_framebuff[384] = {0};


typedef struct 
{
	int16_t x_size;
	int16_t y_size;
	const uint8_t *p_data;
	unsigned char x_align_flag;
}ui_bitmap_t;

void ui_draw_picture(const ui_bitmap_t *p_bitmap, int x, int y);

//0
static const unsigned char picture_zero_data[] =
{
	0x03,0xE0,0x7F,0x0F,0xF8,0x7F,0x1F,0xFC,0x7F,0x3C,0x1E,0x7F,0x78,0x0F,0x7F,0x70,
	0x07,0x7F,0xE0,0x03,0xFF,0xE0,0x03,0xFF,0xE0,0x03,0xFF,0xE0,0x03,0xFF,0xE0,0x03,
	0xFF,0xE0,0x03,0xFF,0xE0,0x03,0xFF,0xE0,0x03,0xFF,0xE0,0x03,0xFF,0xE0,0x03,0xFF,
	0xE0,0x03,0xFF,0xE0,0x03,0xFF,0xE0,0x03,0xFF,0xE0,0x03,0xFF,0xE0,0x03,0xFF,0xE0,
	0x03,0xFF,0x70,0x07,0x7F,0x78,0x0F,0x7F,0x3C,0x1E,0x7F,0x1F,0xFC,0x7F,0x0F,0xF8,
	0x7F,0x03,0xE0,0x7F
};
const ui_bitmap_t picture_zero_map =
{
	.x_size = 17,
	.y_size = 28,
	.p_data = picture_zero_data,
	.x_align_flag = 1,
};

//1
static const unsigned char picture_one_data[] =
{
	0x01,0xFF,0x03,0xFF,0x07,0xFF,0x0F,0xFF,0x7F,0xFF,0x7F,0xFF,0x7F,0xFF,0x03,0xFF,
	0x03,0xFF,0x03,0xFF,0x03,0xFF,0x03,0xFF,0x03,0xFF,0x03,0xFF,0x03,0xFF,0x03,0xFF,
	0x03,0xFF,0x03,0xFF,0x03,0xFF,0x03,0xFF,0x03,0xFF,0x03,0xFF,0x03,0xFF,0x03,0xFF,
	0x03,0xFF,0x03,0xFF,0x03,0xFF,0x03,0xFF
};
const ui_bitmap_t picture_one_map =
{
	.x_size = 9,
	.y_size = 28,
	.p_data = picture_one_data,
	.x_align_flag = 1,
};

//2
static const unsigned char picture_two_data[] =
{
	0x01,0xF8,0x1F,0x07,0xFE,0x1F,0x0F,0xFF,0x1F,0x1E,0x07,0x9F,0x3C,0x03,0xDF,0x38,
	0x01,0xDF,0x70,0x00,0xFF,0x70,0x00,0xFF,0x70,0x00,0xFF,0x30,0x00,0xFF,0x00,0x00,
	0xFF,0x00,0x01,0xDF,0x00,0x03,0xDF,0x00,0x07,0x9F,0x00,0x0F,0x1F,0x00,0x3E,0x1F,
	0x00,0xFC,0x1F,0x03,0xF0,0x1F,0x0F,0xC0,0x1F,0x1F,0x00,0x1F,0x3C,0x00,0x1F,0x78,
	0x00,0x1F,0xF0,0x00,0x1F,0xE0,0x00,0x1F,0xE0,0x00,0x1F,0xFF,0xFF,0xFF,0xFF,0xFF,
	0xFF,0xFF,0xFF,0xFF
};
const ui_bitmap_t picture_two_map =
{
	.x_size = 19,
	.y_size = 28,
	.p_data = picture_two_data,
	.x_align_flag = 1,
};

//3
static const unsigned char picture_three_data[] =
{
	0x07,0xF8,0x1F,0x1F,0xFE,0x1F,0x3F,0xFF,0x1F,0x7C,0x0F,0x9F,0x78,0x07,0x9F,0xF0,
	0x03,0xDF,0xE0,0x01,0xDF,0xE0,0x01,0xDF,0xE0,0x03,0xDF,0x00,0x07,0x9F,0x00,0x0F,
	0x9F,0x00,0x1F,0x1F,0x01,0xFE,0x1F,0x01,0xFE,0x1F,0x01,0xFF,0x1F,0x00,0x0F,0x9F,
	0x00,0x07,0xDF,0x00,0x03,0xDF,0x00,0x01,0xFF,0xE0,0x01,0xFF,0xE0,0x01,0xFF,0xE0,
	0x01,0xFF,0xF0,0x03,0xDF,0x78,0x07,0xDF,0x7C,0x0F,0x9F,0x3F,0xFF,0x1F,0x1F,0xFE,
	0x1F,0x07,0xF8,0x1F
};
const ui_bitmap_t picture_three_map =
{
	.x_size = 19,
	.y_size = 28,
	.p_data = picture_three_data,
	.x_align_flag = 1,
};

//4
static const unsigned char picture_four_data[] =
{
	0x00,0x03,0x0F,0x00,0x07,0x0F,0x00,0x0F,0x0F,0x00,0x1F,0x0F,0x00,0x3F,0x0F,0x00,
	0x7F,0x0F,0x00,0xF7,0x0F,0x01,0xE7,0x0F,0x03,0xC7,0x0F,0x07,0x87,0x0F,0x0F,0x07,
	0x0F,0x1E,0x07,0x0F,0x3C,0x07,0x0F,0x78,0x07,0x0F,0x70,0x07,0x0F,0xE0,0x07,0x0F,
	0xE0,0x07,0x0F,0xFF,0xFF,0xFF,0xFF,0xFF,0xFF,0xFF,0xFF,0xFF,0x00,0x07,0x0F,0x00,
	0x07,0x0F,0x00,0x07,0x0F,0x00,0x07,0x0F,0x00,0x07,0x0F,0x00,0x07,0x0F,0x00,0x07,
	0x0F,0x00,0x07,0x0F	
};
const ui_bitmap_t picture_four_map =
{
	.x_size = 20,
	.y_size = 28,
	.p_data = picture_four_data,
	.x_align_flag = 1,
};

//5
static const unsigned char picture_five_data[] =
{
	0x1F,0xFF,0x9F,0x1F,0xFF,0x9F,0x1F,0xFF,0x9F,0x38,0x00,0x1F,0x38,0x00,0x1F,0x38,
	0x00,0x1F,0x78,0x00,0x1F,0x70,0x00,0x1F,0x70,0x00,0x1F,0x73,0xF0,0x1F,0xF7,0xFC,
	0x1F,0xFF,0xFE,0x1F,0xFC,0x0F,0x1F,0xF8,0x07,0x9F,0xF0,0x03,0xDF,0x00,0x01,0xDF,
	0x00,0x01,0xFF,0x00,0x00,0xFF,0x00,0x00,0xFF,0x00,0x00,0xFF,0xC0,0x01,0xFF,0xE0,
	0x01,0xDF,0xF0,0x03,0xDF,0x78,0x07,0x9F,0x3C,0x0F,0x1F,0x1F,0xFE,0x1F,0x0F,0xFC,
	0x1F,0x03,0xF0,0x1F
};
const ui_bitmap_t picture_five_map =
{
	.x_size = 19,
	.y_size = 28,
	.p_data = picture_five_data,
	.x_align_flag = 1,
};

//6
static const unsigned char picture_six_data[] =
{
	0x01,0xF8,0x0F,0x07,0xFE,0x0F,0x0F,0xFF,0x0F,0x1E,0x07,0x8F,0x3C,0x03,0xCF,0x38,
	0x01,0xCF,0x70,0x00,0xEF,0x70,0x00,0xEF,0xF0,0x00,0x0F,0xE0,0x00,0x0F,0xE0,0xF8,
	0x0F,0xE3,0xFE,0x0F,0xEF,0xFF,0x8F,0xFF,0x07,0xCF,0xFC,0x01,0xEF,0xF8,0x00,0xEF,
	0xF8,0x00,0xFF,0xF0,0x00,0x7F,0xF0,0x00,0x7F,0xF0,0x00,0x7F,0x70,0x00,0x7F,0x78,
	0x00,0xFF,0x38,0x00,0xEF,0x3C,0x01,0xEF,0x1F,0x07,0xCF,0x0F,0xFF,0x8F,0x07,0xFF,
	0x0F,0x00,0xF8,0x0F
};
const ui_bitmap_t picture_six_map =
{
	.x_size = 20,
	.y_size = 28,
	.p_data = picture_six_data,
	.x_align_flag = 1,
};

//7
static const unsigned char picture_seven_data[] =
{
	0xFF,0xFF,0xFF,0xFF,0xFF,0xFF,0xFF,0xFF,0xFF,0x00,0x01,0xDF,0x00,0x03,0xDF,0x00,
	0x07,0x9F,0x00,0x0F,0x1F,0x00,0x0E,0x1F,0x00,0x1C,0x1F,0x00,0x38,0x1F,0x00,0x38,
	0x1F,0x00,0x70,0x1F,0x00,0x70,0x1F,0x00,0xE0,0x1F,0x00,0xE0,0x1F,0x01,0xC0,0x1F,
	0x01,0xC0,0x1F,0x01,0xC0,0x1F,0x03,0x80,0x1F,0x03,0x80,0x1F,0x03,0x80,0x1F,0x07,
	0x00,0x1F,0x07,0x00,0x1F,0x07,0x00,0x1F,0x0F,0x00,0x1F,0x0E,0x00,0x1F,0x0E,0x00,
	0x1F,0x0E,0x00,0x1F
};
const ui_bitmap_t picture_seven_map =
{
	.x_size = 19,
	.y_size = 28,
	.p_data = picture_seven_data,
	.x_align_flag = 1,
};

//8
static const unsigned char picture_eight_data[] =
{
	0x01,0xF8,0x0F,0x0F,0xFF,0x0F,0x1F,0xFF,0x8F,0x3C,0x03,0xCF,0x38,0x01,0xCF,0x70,
	0x00,0xEF,0x70,0x00,0xEF,0x70,0x00,0xEF,0x70,0x00,0xEF,0x38,0x01,0xCF,0x3C,0x03,
	0xCF,0x1F,0xFF,0x8F,0x07,0xFE,0x0F,0x1F,0xFF,0x8F,0x3C,0x03,0xCF,0x78,0x01,0xEF,
	0x70,0x00,0xEF,0xE0,0x00,0x7F,0xE0,0x00,0x7F,0xE0,0x00,0x7F,0xE0,0x00,0x7F,0xE0,
	0x00,0x7F,0x70,0x00,0xEF,0x78,0x01,0xEF,0x3C,0x03,0xCF,0x1F,0xFF,0x8F,0x07,0xFE,
	0x0F,0x00,0xF0,0x0F
};
const ui_bitmap_t picture_eight_map =
{
	.x_size = 20,
	.y_size = 28,
	.p_data = picture_eight_data,
	.x_align_flag = 1,
};

//9
static const unsigned char picture_nine_data[] =
{
	0x01,0xF8,0x1F,0x07,0xFE,0x1F,0x0F,0xFF,0x1F,0x1E,0x07,0x9F,0x3C,0x03,0xDF,0x38,
	0x01,0xDF,0x70,0x00,0xFF,0x70,0x00,0xFF,0x70,0x00,0xFF,0x70,0x00,0xFF,0x70,0x00,
	0xFF,0x70,0x00,0xFF,0x38,0x01,0xFF,0x3C,0x03,0xFF,0x1E,0x07,0xFF,0x0F,0xFE,0xFF,
	0x07,0xFC,0xFF,0x01,0xF0,0xFF,0x00,0x00,0xFF,0x00,0x00,0xFF,0x70,0x01,0xDF,0x70,
	0x01,0xDF,0x38,0x03,0x9F,0x3C,0x07,0x9F,0x1E,0x0F,0x1F,0x0F,0xFE,0x1F,0x07,0xFC,
	0x1F,0x01,0xF0,0x1F
};
const ui_bitmap_t picture_nine_map =
{
	.x_size = 19,
	.y_size = 28,
	.p_data = picture_nine_data,
	.x_align_flag = 1,
};

//强
static const unsigned char picture_qiang_data[] =
{
	0xF3,0xEF,0x12,0x2F,0x13,0xEF,0xF0,0x8F,0x87,0xFF,0x84,0x9F,0xF4,0x9F,0x17,0xFF,
	0x10,0x8F,0x10,0x9F,0xF7,0xFF
};
const ui_bitmap_t picture_qiang_map =
{
	.x_size = 12,
	.y_size = 11,
	.p_data = picture_qiang_data,
	.x_align_flag = 1,
};

//度
static const unsigned char picture_du_data[] =
{
	0x02,0x0F,0xFF,0xFF,0x88,0x8F,0xBF,0xEF,0x88,0x8F,0x8F,0x8F,0x80,0x0F,0xBF,0xEF,
	0x98,0xCF,0x8D,0x8F,0xBF,0xCF,0xE0,0x7F,
};
const ui_bitmap_t picture_du_map =
{
	.x_size = 12,
	.y_size = 12,
	.p_data = picture_du_data,
	.x_align_flag = 1,
};

//断开连接
static const unsigned char picture_disconnect_data[] =
{
	0x00,0xFF,0x01,0xBF,0xFF,0xFF,0x86,0x7F,0x8C,0x7F,0x98,0x7F,0xFF,0xFF,0x60,0x3F,
	0xC0,0x3F
};
const ui_bitmap_t picture_disconnect_map =
{
	.x_size = 10,
	.y_size = 9,
	.p_data = picture_disconnect_data,
	.x_align_flag = 1,
};

//连接
static const unsigned char picture_connect_data[] =
{
	0xFF,0xFF,0x80,0x7F,0x80,0x7F,0x80,0x7F,0xFF,0xFF
};
const ui_bitmap_t picture_connect_map =
{
	.x_size = 10,
	.y_size = 5,
	.p_data = picture_connect_data,
	.x_align_flag = 1,
};

//锁
static const unsigned char picture_lock_data[] =
{
	0x3F,0x3F,0x61,0xBF,0x61,0xBF,0x61,0xBF,0xFF,0xFF,0xFF,0xFF,0xFF,0xFF,0xFF,0xFF,
	0xFF,0xFF,0x7F,0xBF	
};
const ui_bitmap_t picture_lock_map =
{
	.x_size = 10,
	.y_size = 10,
	.p_data = picture_lock_data,
	.x_align_flag = 1,
};

//解锁
static const unsigned char picture_unlock_data[] =
{
	0x3F,0x3F,0x61,0xBF,0x01,0xBF,0x01,0xBF,0xFF,0xFF,0xFF,0xFF,0xFF,0xFF,0xFF,0xFF,
	0xFF,0xFF,0x7F,0xBF
};


const ui_bitmap_t picture_unlock_map =
{
	.x_size = 10,
	.y_size = 10,
	.p_data = picture_unlock_data,
	.x_align_flag = 1,
};

//clear lock
static const unsigned char picture_clear_lock_data[] =
{
	0x00,0x00,0x00,0x00,0x00,0x00,0x00,0x00,0x00,0x00,0x00,0x00,0x00,0x00,0x00,0x00,
	0x00,0x00,0x00,0x00
};

const ui_bitmap_t picture_clear_lock_map =
{
	.x_size = 10,
	.y_size = 10,
	.p_data = picture_clear_lock_data,
	.x_align_flag = 1,
};

//断开连接
static const unsigned char picture_full_screen_disconnect_data[] =
{
	0x00,0x00,0x00,0x3F,0x3F,0x00,0x00,0x00,0x3F,0x3F,0x00,0x00,0x00,0xFC,0x3F,0x00,
	0x00,0x00,0xFC,0x3F,0xFF,0xFF,0xFF,0xFF,0xFF,0xFF,0xFF,0xFF,0xFF,0xFF,0xFF,0xFF,
	0xFF,0xFF,0xFF,0xFF,0xFF,0xFF,0xFF,0xFF,0xF0,0x00,0x3F,0x03,0xFF,0xF0,0x00,0x3F,
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	0x00,0x3F
};
const ui_bitmap_t picture_full_screen_disconnect_map =
{
	.x_size = 34,
	.y_size = 26,
	.p_data = picture_full_screen_disconnect_data,
	.x_align_flag = 1,
};

//错误提示符E
static const unsigned char picture_err_data[] =
{
	0xFF,0xFF,0xFF,0xFF,0xFF,0xFF,0xFF,0xFF,0xFF,0xFF,0xFF,0xFF,0xF0,0x00,0x1F,0xF0,
	0x00,0x1F,0xF0,0x00,0x1F,0xF0,0x00,0x1F,0xF0,0x00,0x1F,0xF0,0x00,0x1F,0xF0,0x00,
	0x1F,0xF0,0x00,0x1F,0xFF,0xFF,0xFF,0xFF,0xFF,0xFF,0xFF,0xFF,0xFF,0xFF,0xFF,0xFF,
	0xF0,0x00,0x1F,0xF0,0x00,0x1F,0xF0,0x00,0x1F,0xF0,0x00,0x1F,0xF0,0x00,0x1F,0xF0,
	0x00,0x1F,0xF0,0x00,0x1F,0xF0,0x00,0x1F,0xFF,0xFF,0xFF,0xFF,0xFF,0xFF,0xFF,0xFF,
	0xFF,0xFF,0xFF,0xFF
};
const ui_bitmap_t picture_err_map =
{
	.x_size = 19,
	.y_size = 28,
	.p_data = picture_err_data,
	.x_align_flag = 1,
};

/*--  文字:  未  --*/
/*--  Fixedsys12;  此字体下对应的点阵为：宽x高=16x16   --*/
static const unsigned char picture_wei_data[] =
{
0x01,0x00,0x01,0x00,0x01,0x00,0x3F,0xF8,0x01,0x00,0x01,0x00,0x01,0x00,0xFF,0xFE,
0x03,0x80,0x05,0x40,0x09,0x20,0x11,0x10,0x21,0x08,0xC1,0x06,0x01,0x00,0x01,0x00
};
const ui_bitmap_t picture_wei_map =
{
	.x_size = 16,
	.y_size = 16,
	.p_data = picture_wei_data,
	.x_align_flag = 1,
};

/*--  文字:  配  --*/
/*--  Fixedsys12;  此字体下对应的点阵为：宽x高=16x16   --*/
static const unsigned char picture_pei_data[] =
{
0x00,0x00,0xFE,0x00,0x28,0xF8,0x28,0x08,0xFE,0x08,0xAA,0x08,0xAA,0x08,0xAA,0xF8,
0xAE,0x88,0xC2,0x80,0x82,0x80,0xFE,0x80,0x82,0x82,0x82,0x82,0xFE,0x7E,0x82,0x00
};
const ui_bitmap_t picture_pei_map =
{
	.x_size = 16,
	.y_size = 16,
	.p_data = picture_pei_data,
	.x_align_flag = 1,
};


/*--  文字:  对  --*/
/*--  Fixedsys12;  此字体下对应的点阵为：宽x高=16x16   --*/
static const unsigned char picture_dui_data[] =
{
0x00,0x10,0x00,0x10,0x00,0x10,0x7E,0x10,0x02,0xFE,0x02,0x10,0x24,0x10,0x14,0x90,
0x08,0x50,0x08,0x50,0x14,0x10,0x12,0x10,0x22,0x10,0x40,0x10,0x00,0x50,0x00,0x20
};

const ui_bitmap_t picture_dui_map =
{
	.x_size = 16,
	.y_size = 16,
	.p_data = picture_dui_data,
	.x_align_flag = 1,
};


void display_wei_pei_dui(void)
{
	ui_draw_picture(&picture_wei_map,24,8); 
	ui_draw_picture(&picture_pei_map,40,8);
  ui_draw_picture(&picture_dui_map,56,8); 
}


void display_ems_level(uint8_t level_value)
{
	switch(level_value)
	{
		case 0:
			ui_draw_picture(&picture_zero_map,14,2); 
			ui_draw_picture(&picture_zero_map,35,2); 
			break;

		case 1:
			ui_draw_picture(&picture_zero_map,14,2); 
			ui_draw_picture(&picture_one_map,37,2);  
			break;

		case 2:
			ui_draw_picture(&picture_zero_map,14,2); 
			ui_draw_picture(&picture_two_map,33,2);  
			break;

		case 3:
			ui_draw_picture(&picture_zero_map,14,2); 
			ui_draw_picture(&picture_three_map,33,2);
			break;

		case 4:
			ui_draw_picture(&picture_zero_map,14,2); 
			ui_draw_picture(&picture_four_map,32,2); 
			break;

		case 5:
			ui_draw_picture(&picture_zero_map,14,2); 
			ui_draw_picture(&picture_five_map,33,2); 
			break;

		case 6:
			ui_draw_picture(&picture_zero_map,14,2); 
			ui_draw_picture(&picture_six_map,32,2);  
			break;

		case 7:
			ui_draw_picture(&picture_zero_map,14,2); 
			ui_draw_picture(&picture_seven_map,33,2);
			break;

		case 8:
			ui_draw_picture(&picture_zero_map,14,2); 
			ui_draw_picture(&picture_eight_map,32,2);
			break;

		case 9:
			ui_draw_picture(&picture_zero_map,14,2); 
			ui_draw_picture(&picture_nine_map,32,2); 
			break;

		case 10:
			ui_draw_picture(&picture_one_map,16,2);  
			ui_draw_picture(&picture_zero_map,35,2); 
			break;

		case 11:
			ui_draw_picture(&picture_one_map,16,2);  
			ui_draw_picture(&picture_one_map,37,2);  
			break;

		case 12:
			ui_draw_picture(&picture_one_map,16,2);  
			ui_draw_picture(&picture_two_map,33,2);  
			break;

		case 13:
			ui_draw_picture(&picture_one_map,16,2);  
			ui_draw_picture(&picture_three_map,33,2);
			break;

		case 14:
			ui_draw_picture(&picture_one_map,16,2);  
			ui_draw_picture(&picture_four_map,32,2); 
			break;

		case 15:
			ui_draw_picture(&picture_one_map,16,2);  
			ui_draw_picture(&picture_five_map,33,2); 
			break;

		case 16:
			ui_draw_picture(&picture_one_map,16,2);  
			ui_draw_picture(&picture_six_map,32,2);  
			break;

		case 17:
			ui_draw_picture(&picture_one_map, 16, 2);  
			ui_draw_picture(&picture_seven_map, 33, 2);
			break;

		case 18:
			ui_draw_picture(&picture_one_map, 16, 2);  
			ui_draw_picture(&picture_eight_map, 32, 2);
			break;

		case 19:
			ui_draw_picture(&picture_one_map, 16, 2);  
			ui_draw_picture(&picture_nine_map, 32, 2); 
			break;

		case 20:
			ui_draw_picture(&picture_two_map, 11, 2);  
			ui_draw_picture(&picture_zero_map, 35, 2); 
			break;

		case 21:
			ui_draw_picture(&picture_two_map, 11, 2);  
			ui_draw_picture(&picture_one_map, 37, 2);  
			break;

		case 22:
			ui_draw_picture(&picture_two_map, 11, 2);  
			ui_draw_picture(&picture_two_map, 33, 2);  
			break;

		case 23:
			ui_draw_picture(&picture_two_map, 11, 2);  
			ui_draw_picture(&picture_three_map, 33, 2);
			break;

		case 24:
			ui_draw_picture(&picture_two_map, 11, 2);  
			ui_draw_picture(&picture_four_map, 32, 2); 
			break;

		case 25:
			ui_draw_picture(&picture_two_map, 11, 2);  
			ui_draw_picture(&picture_five_map, 33, 2); 
			break;

		case 26:
			ui_draw_picture(&picture_two_map, 11, 2);  
			ui_draw_picture(&picture_six_map, 32, 2);  
			break;

		case 27:
			ui_draw_picture(&picture_two_map, 11, 2);  
			ui_draw_picture(&picture_seven_map, 33, 2);
			break;

		case 28:
			ui_draw_picture(&picture_two_map, 11, 2);  
			ui_draw_picture(&picture_eight_map, 32, 2);
			break;

		case 29:
			ui_draw_picture(&picture_two_map, 11, 2);  
			ui_draw_picture(&picture_nine_map, 32, 2); 
			break;

		case 30:
			ui_draw_picture(&picture_three_map, 13, 2);
			ui_draw_picture(&picture_zero_map, 35, 2); 
			break;

		default:
			break;
    }
	
	ui_draw_picture(&picture_qiang_map, 59, 3);
	ui_draw_picture(&picture_du_map, 59, 17);
}

void display_lock_and_radio_state(bool radio_state, bool lock_state)
{	
	if(radio_state)
	{
		ui_draw_picture(&picture_connect_map, 77, 5);
	}
	else
	{
		ui_draw_picture(&picture_disconnect_map, 77, 3);
	}
	
	if(lock_state)
	{
		ui_draw_picture(&picture_lock_map, 77, 19);
	}
	else
	{
		ui_draw_picture(&picture_unlock_map, 77, 19);
	}
}


void radio_state_display(_RADIO_STATE_e radio_state)
{
	if(CONNECTED == radio_state)
	{
		ui_draw_picture(&picture_connect_map, 77, 5);
	}
	else
	{
		ui_draw_picture(&picture_disconnect_map, 77, 3);
	}
}


void lock_state_display(_LOCK_STATE lock_state)
{

	if(Locked == lock_state)
	{
		ui_draw_picture(&picture_lock_map, 77, 19);
	}
	else
	{
		ui_draw_picture(&picture_unlock_map, 77, 19);
	}
}




void display_clear_lock(void)
{
	ui_draw_picture(&picture_clear_lock_map, 77, 19);
}

void display_full_screen_disconnect(void)
{
	ui_draw_picture(&picture_full_screen_disconnect_map, 31, 3);
}

void display_err_show(eALARM_TYPE err_value)
{
	switch(err_value)
	{
		case BAT_LOW_ALARM:
			ui_draw_picture(&picture_err_map, 13, 2);
			ui_draw_picture(&picture_one_map, 37, 2);
			break;

		case HEAT_OVER_ALARM:
			ui_draw_picture(&picture_err_map, 13, 2);
			ui_draw_picture(&picture_two_map, 33, 2);
			break;

		case NTC_FAULT_ALARM:
			ui_draw_picture(&picture_err_map, 13, 2);
			ui_draw_picture(&picture_three_map, 33, 2);
			break;

		default:
			break;
	}
}


extern void OLED_Write_Cmd(uint8_t cmd);

static void oled_set_start_page(uint8_t page)
{
    OLED_Write_Cmd(0xB0 | page);
}

static void oled_set_start_column(void)
{ 
    OLED_Write_Cmd(0x11);
	OLED_Write_Cmd(0x02);
}

extern void OLED_Write_Data(uint8_t sdata);

//void update_to_oled(void)
//{
//	uint8_t *p_temp_lcd_buff = lcd_framebuff;
//    uint8_t page;
//	uint8_t page_buff[96] = {0};
//	uint16_t i;
//	
//    for(page=0; page<4; page++)
//    {
//    	oled_set_start_page(page);
//		oled_set_start_column();

//        memcpy(page_buff, p_temp_lcd_buff + page * 96, 96);

//		for(i=0; i<sizeof(page_buff); i++)
//		{
//			OLED_Write_Data(page_buff[i]);
//		}
//    }
//}


uint8_t butterfly_computation(uint8_t data)
{
         data = (data << 4) | (data >> 4);
         data = ((data << 2)&0xcc) | ((data >> 2)&0x33);
         data = ((data << 1)&0xaa) | ((data >> 1)&0x55);

         return data;
}

void update_to_oled(void)
{
	uint8_t *p_temp_lcd_buff = lcd_framebuff;
    uint8_t page;
	uint8_t page_buff[96] = {0};
	uint16_t i;
	
    for(page=0; page<4; page++)
    {
    	oled_set_start_page(page);
		oled_set_start_column();

        memcpy(page_buff, p_temp_lcd_buff + (3-page) * 96, 96);

		for(i=0; i<sizeof(page_buff); i++)
		{
			 uint8_t temp=butterfly_computation(page_buff[95-i]);
			 OLED_Write_Data(temp);
		}
    }
}


static void ui_draw_point(int x, int y, uint8_t color)
{
	int pos;
	uint8_t *p_lcd_fbuf;
	uint8_t const bitm[] = {0x01, 0x02, 0x04, 0x08, 0x10, 0x20, 0x40, 0x80};
	uint8_t const rebitm[] = {0xfe, 0xfd, 0xfb, 0xf7, 0xef, 0xdf, 0xbf, 0x7f};

	if((x < 0) || (y < 0) || (x >= 96) || (y >= 32))
	{
		return ;
	}
	
	pos = y & 0x07;	  
	p_lcd_fbuf = &(lcd_framebuff[(y >> 3) * 96 + x]);

	if(color == 0xff)
	{
		*p_lcd_fbuf |= bitm[pos];
	}
	else
	{
		*p_lcd_fbuf &= rebitm[pos];
	}
}

void ui_lcd_clear(uint8_t color)
{
	memset((void *)lcd_framebuff, color, sizeof(lcd_framebuff));
}

void ui_draw_clear_screen(void)
{
	ui_lcd_clear(0);
}

void ui_draw_buffer(const uint8_t *ptr, int is_font, int x, int y, int buffer_x_size, int buffer_y_size, uint8_t x_align_flag)
{
	uint8_t color, inv_color;
	const uint8_t *p_pic = ptr;
	const uint8_t bitm[] = {0x80, 0x40, 0x20, 0x10, 0x08, 0x04, 0x02, 0x01};
	int x_s, x_e, y_s, y_e, x0, y0;
	uint16_t x_pos, y_pos, x_offset, y_offset;
	uint16_t x_align_size;

	if((buffer_x_size > 96) || (buffer_y_size > 32))
	{
		return;
	}

	x_s = x;
	x_e = x + buffer_x_size;
	y_s = y;
	y_e = y + buffer_y_size;
	if((x_e < 0) || (x_s >= 96) || (y_e < 0) || (y_s >= 32))
	{
		return;
	}

	if(x_s < 0)
	{
		x_pos = -x_s;
		x_s = 0;
	}
	else
	{
		x_pos = 0;
	}
	
	if(x_e > 96)
	{
		x_e = 96;
	}

	if(y_s < 0)
	{
		y_pos = -y_s;
		y_s = 0;
	}
	else
	{
		y_pos = 0;
	}
	
	if(y_e > 96)
	{
		y_e = 96;
	}

	if(!is_font) 
	{
		color = 0;
	}
	else
	{
		color = 0xff;
	}

	if(color == 0)
	{
		inv_color = 0xff;
	}
	else
	{
		inv_color = 0;
	}

	x_align_size = x_align_flag > 0 ? ((buffer_x_size+7)/8)*8 : buffer_x_size;
	y_offset = y_pos * x_align_size;
	for(y0=y_s; y0<y_e; y0++)
	{
		x_offset = x_pos;
		for(x0=x_s; x0<x_e; x0++, x_offset++)
		{
			p_pic = &ptr[(y_offset + x_offset) / 8];
			if(*p_pic & bitm[x_offset % 8])
			{
				ui_draw_point(x0, y0, color);		
			}
			else
			{
				ui_draw_point(x0, y0, inv_color);
			}
		}

		y_offset += x_align_size;
	}
}

void ui_draw_picture(const ui_bitmap_t *p_bitmap, int x, int y)
{
	ui_draw_buffer(p_bitmap->p_data, 1, x, y, p_bitmap->x_size, p_bitmap->y_size, p_bitmap->x_align_flag);
}

void OLED_SH1106_Init(void)
{
    uint16_t time;
	
    OLED_CS_LOW;
    OLED_RST_HIGH;
    time = 5000;
    while(time--);

    OLED_RST_LOW;
    time = 10000;
    while(time--);

    OLED_RST_HIGH;
    time = 10000;
    while(time--);

    time = 10000;
    while(time--);
	
	OLED_Write_Cmd(0xAE);    

	OLED_Write_Cmd(0xd5);    
	OLED_Write_Cmd(0x51);    

	OLED_Write_Cmd(0xA8);    
	OLED_Write_Cmd(0x1F);

	OLED_Write_Cmd(0xD3);    
	OLED_Write_Cmd(0x10);

	OLED_Write_Cmd(0x40);    

	OLED_Write_Cmd(0xAD);    
	OLED_Write_Cmd(0x8B);    

	OLED_Write_Cmd(0x31);    

	OLED_Write_Cmd(0xA1);    

	OLED_Write_Cmd(0xC8);    

	OLED_Write_Cmd(0xDA);    
	OLED_Write_Cmd(0x12);

	OLED_Write_Cmd(0x81);    
	OLED_Write_Cmd(0xa0);	

	OLED_Write_Cmd(0xD9);	 
	OLED_Write_Cmd(0x22);

	OLED_Write_Cmd(0xDB);    
	OLED_Write_Cmd(0x25);	 

	OLED_Write_Cmd(0xA4);    

	OLED_Write_Cmd(0xA6);    

	OLED_Write_Cmd(0xAF);    
}


